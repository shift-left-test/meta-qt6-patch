## conf/layer.conf
```bitbake
BBPATH =. "${LAYERDIR}:"

BBFILES += " \
    ${LAYERDIR}/recipes-*/*/*.bb \
    ${LAYERDIR}/recipes-*/*/*.bbappend \
"

BBFILE_COLLECTIONS += "qt6-layer-patch"
BBFILE_PATTERN_qt6-layer-patch = "^${LAYERDIR}/"
BBFILE_PRIORITY_qt6-layer-patch = "17"

LAYERDEPENDS_qt6-layer-patch = "qt6-layer"
LAYERSERIES_COMPAT_qt6-layer-patch = "dunfell gatesgarth hardknott honister kirkstone langdale"
```
